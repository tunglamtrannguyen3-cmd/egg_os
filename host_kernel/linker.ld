/* host_kernel/linker.ld */
ENTRY(_start)

SECTIONS
{
    . = 0xffffffff80100000;

    .text : {
        *(.text .text.*)
    }

    .rodata : {
        *(.rodata .rodata.*)
    }

    .data : {
        *(.data .data.*)
    }

    .bss : {
        *(.bss .bss.*)
    }
}

